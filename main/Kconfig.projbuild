## main/Kconfig.projbuild
```kconfig
menu "IOTA Wallet"

    menu "WiFi"
        config ESP_WIFI_SSID
            string "WiFi SSID"
            default "myssid"
            help
                SSID (network name) for the example to connect to.

        config ESP_WIFI_PASSWORD
            string "WiFi Password"
            default "mypassword"
            help
                WiFi password (WPA or WPA2) for the example to use.

        config ESP_MAXIMUM_RETRY
            int "Maximum retry"
            default 5
            help
                Set the Maximum retry to avoid station reconnecting to the AP unlimited when the AP is really inexistent.
    endmenu

    menu "SNTP"
        config SNTP_SERVER
            string "SNTP server"
            default "pool.ntp.org"
            help
                Endpoint of Network Time Protocol server.

        config SNTP_TZ
            string "Timezone"
            default "CST-8"
            help
                POSIX timezone. Ref: https://github.com/nayarsystems/posix_tz_db/blob/master/zones.json
    endmenu

    config IOTA_NODE_URL
        string "IOTA Node URL"
        default "https://api.lb-0.testnet.chrysalis2.com/"
        help
            The URL of an IOTA node.

    config IOTA_NODE_PORT
        int "port number"
        default 0
        help
            The API port of the IOTA node.

    config WALLET_SEED
        string "Wallet SEED"
        default "random"
        help
            The seed of this wallet

    config SENSOR_DELAY_SCALE
        int "Sensor Sampling Period"
        default 60
        help
            The scale of sampling period

    config IOTA_UNIT_TESTS
        bool "Testing Application"
        default n
        help
            Build unit tests application
endmenu
```

## sdkconfig.defaults
```kconfig
CONFIG_ESP_MAIN_TASK_STACK_SIZE=20480
CONFIG_ESP_TASK_WDT=n
CONFIG_ESP_TLS_INSECURE=y
CONFIG_ESP_TLS_SKIP_SERVER_CERT_VERIFY=y
CONFIG_PARTITION_TABLE_SINGLE_APP_LARGE=y
CONFIG_ESP32C3_REV_MIN_2=y
CONFIG_ESP32C3_REV_MIN=2
```
